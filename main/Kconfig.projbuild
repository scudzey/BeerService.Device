## main/Kconfig.projbuild
```kconfig
menu "Device Flow Configuation"

    config BLINK_GPIO
        int "Blink GPIO number"
        range 0 34
        default 5
        help
            GPIO number (IOxx) to blink on and off.

            Some GPIOs are used for other purposes (flash connections, etc.) and cannot be used to blink.

            GPIOs 35-39 are input-only so cannot be used as outputs.

    config ESP_WIFI_SSID
        string "WiFi SSID"
        default "myssid"
        help
            SSID (network name) for the device to connect to.
    
    config ESP_WIFI_PASSOWRD
        string "WiFi Password"
        default "mypassword"
        help
            WiFi passwword (WPA or WPA2) for the device to use.

    config ESP_MAXIMUM_RETRY
        int "Maximum retry"
        default 5
        help
            Set the maximum retry to avoid station reconnecting to the AP repeatedly when unavailable.

    config AWS_IOT_THING_NAME
        string "AWS IoT Thing Name"
        default "BeverageFlowUnit"
        help
            AWS IoT Thing Name

    config AWS_IOT_CLIENT_ID
        string "AWS IoT Client ID"
        default "ESP32-CLIENT"
        help
            AWS IoT Client Name

endmenu
```
